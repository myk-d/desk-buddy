## firmware/sdkconfig.defaults
```kconfig
# PSRAM конфігурація для ESP32-S3 N16R8
# Кладеться в корінь проекту поруч з platformio.ini

CONFIG_SPIRAM=y
CONFIG_SPIRAM_MODE_OCT=y
CONFIG_SPIRAM_SPEED_80M=y
CONFIG_SPIRAM_USE_CAPS_ALLOC=y
CONFIG_SPIRAM_MALLOC_ALWAYSINTERNAL=16384
```
